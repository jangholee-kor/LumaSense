## firmware/main/Kconfig.projbuild
```kconfig
menu "Smart Monitor Controller"
    config SMC_PRESENCE_VL53L1X
        bool "Use VL53L1X ToF instead of LD2412 radar"
        default n
    config SMC_WIFI_TX_POWER_LIMIT
        bool "Limit Wi-Fi transmit power after startup"
        depends on SMC_PRESENCE_VL53L1X
        default n
        help
            Apply the limit before attempting an access point connection.
            Disabled leaves the driver's default transmit power unchanged.
    config SMC_WIFI_MAX_TX_POWER_QDBM
        int "Maximum Wi-Fi transmit power (0.25 dBm units: 60=15, 44=11, 34=8.5)"
        depends on SMC_WIFI_TX_POWER_LIMIT
        default 60
        range 8 84
        help
            ESP-IDF maps requests to supported power steps and applies PHY
            and country restrictions. The status query reports driver readback,
            which is not a measurement of radiated RF power.
    config SMC_TOF_SHUT_GPIO
        int "VL53L1X SHUT GPIO (confirmed SuperMini wiring: 4)"
        default 4
        range 0 48
        depends on SMC_PRESENCE_VL53L1X
    config SMC_TOF_ROI_SIZE
        int "VL53L1X centered square ROI size (4..16 SPADs)"
        default 8
        range 4 16
        depends on SMC_PRESENCE_VL53L1X
    config SMC_STATUS_LED_ENABLE
        bool "Use on-board SK6812MINI-HS RGB sensor status LED"
        default y
    config SMC_STATUS_LED_GPIO
        int "Status RGB LED GPIO (on-board D10: GPIO38)"
        default 38
        range 0 48
        depends on SMC_STATUS_LED_ENABLE
    config SMC_STATUS_LED_BRIGHTNESS
        int "Status RGB LED channel brightness (0=off, 4=default, max 32/255)"
        default 4
        range 0 32
        depends on SMC_STATUS_LED_ENABLE
    config SMC_I2C_SDA
        int "BH1750 SDA GPIO (example wiring)"
        default 8
        range 0 48
    config SMC_I2C_SCL
        int "BH1750 SCL GPIO (example wiring)"
        default 9
        range 0 48
    config SMC_BH1750_ADDR
        hex "BH1750 7-bit I2C address"
        default 0x23
        range 0x23 0x5c
    config SMC_RADAR_RX
        int "ESP32 RX GPIO connected to LD2412 TX (example wiring)"
        default 16
        range 0 48
    config SMC_RADAR_TX
        int "ESP32 TX GPIO connected to LD2412 RX (example wiring)"
        default 17
        range 0 48
    config SMC_RADAR_BAUD
        int "LD2412 UART baud rate"
        default 115200
        range 9600 460800
    config SMC_REPORT_MS
        int "Telemetry interval (ms)"
        default 200
        range 100 5000
    config SMC_RADAR_STALE_MS
        int "Radar data stale timeout (ms)"
        default 2000
        range 500 10000
endmenu
```
